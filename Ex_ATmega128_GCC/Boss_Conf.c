/*
*=====*=====*=====*=====*=====*=====*=====*=====*=====*=====*=====*=====*=====*
*                                                                             *
*                 RT-BOSS (Config File)         [ ATmega128 ]                 *
*                                                                             *
*=====*=====*=====*=====*=====*=====*=====*=====*=====*=====*=====*=====*=====*
*/

/*===========================================================================*/
/*                               INCLUDE FILE                                */
/*---------------------------------------------------------------------------*/
#include "Boss.h"
#include <avr/io.h>
#include <avr/interrupt.h>

/*===========================================================================*/
/*                      DEFINITIONS & TYPEDEFS & MACROS                      */
/*---------------------------------------------------------------------------*/

/*===========================================================================*/
/*                             GLOBAL VARIABLES                              */
/*---------------------------------------------------------------------------*/

/*===========================================================================*/
/*                            FUNCTION PROTOTYPES                            */
/*---------------------------------------------------------------------------*/
void _Boss_tick_sleep(boss_tmr_t tick_ms);
void _Boss_tick_timer(boss_tmr_t tick_ms);


/*===========================================================================
    B O S S _ T I C K
---------------------------------------------------------------------------*/
void _Boss_tick(void)
{
  boss_tmr_t tick_ms = _BOSS_TICK_MS_;
  
  _Boss_tick_sleep(tick_ms);
  _Boss_tick_timer(tick_ms);
}


/*===========================================================================
    B O S S _ S L E E P
---------------------------------------------------------------------------*/
void Boss_sleep(boss_tmr_t sleep_ms)
{
  (void)Boss_wait(BOSS_SIGS_NULL, sleep_ms);
}


/*===========================================================================
    B O S S _ S L E E P _ H M S
---------------------------------------------------------------------------*/
void Boss_sleep_hms(boss_byte_t h, boss_byte_t m, boss_byte_t s)
{
  boss_u32_t hms;
  
  hms = ((boss_u32_t)h*60*60) + ((boss_u32_t)m*60) + (boss_u32_t)s;
  hms = hms * 1000; /* ms */

  while(hms != 0)
  {
    boss_tmr_t sleep_ms = ~((boss_tmr_t)0);   /* 타이머 카운트 최대값 */
                                              /* 32bit : 0xFFFFFFFF   */
                                              /* 16bit : 0xFFFF       */
                                              /*  8bit : 0xFF         */
    if( (boss_u32_t)sleep_ms < hms )
    {
      hms = hms - (boss_u32_t)sleep_ms;
    }
    else
    {
      sleep_ms = (boss_tmr_t)hms;
      hms = 0;
    }
    
    (void)Boss_wait(BOSS_SIGS_NULL, sleep_ms);
  }
}



/*===========================================================================
    _   B   O   S   S _   T   M   R _   A   L   L   O   C
---------------------------------------------------------------------------*/
void *_BOSS_TMR_ALLOC(boss_uptr_t size)
{
  return Boss_mem_alloc(size);
}


/*===========================================================================
    _   B   O   S   S _   T   M   R _   F   R   E   E
---------------------------------------------------------------------------*/
void _BOSS_TMR_FREE(void *p_tmr)
{
  Boss_mem_free(p_tmr);
}



/*===========================================================================
    _   B   O   S   S _   M   S   G _   F   I   F   O _   A   L   L   O   C
---------------------------------------------------------------------------*/
void *_BOSS_MSG_FIFO_ALLOC(boss_uptr_t size)
{
  return Boss_mem_alloc(size);
}


/*===========================================================================
    _   B   O   S   S _   M   S   G _   F   I   F   O _   F   R   E   E
---------------------------------------------------------------------------*/
void _BOSS_MSG_FIFO_FREE(void *msg_fifo)
{
  Boss_mem_free(msg_fifo);
}



/*===========================================================================
_   B   O   S   S _   M   A   I   L _   Q _   B   O   X _   A   L   L   O   C
---------------------------------------------------------------------------*/
void *_BOSS_MAIL_Q_BOX_ALLOC(boss_uptr_t size)
{
  return Boss_mem_alloc(size);
}


/*===========================================================================
_   B   O   S   S _   M   A   I   L _   Q _   B   O   X _   F   R   E   E
---------------------------------------------------------------------------*/
void _BOSS_MAIL_Q_BOX_FREE(void *h_mbox)
{
  Boss_mem_free(h_mbox);
}



/*
*=====*=====*=====*=====*=====*=====*=====*=====*=====*=====*=====*=====*=====*
*                                                                             *
*                         RT-BOSS ( IDLE TASK )                               *
*                                                                             *
*=====*=====*=====*=====*=====*=====*=====*=====*=====*=====*=====*=====*=====*
*/

boss_tcb_t idle_task[1];
boss_stk_t idle_stack[ _IDLE_STACK_BYTES / sizeof(boss_stk_t) ];

/*===========================================================================
    I D L E _ T A S K
---------------------------------------------------------------------------*/
void idle_task_exe(void)
{
  for(;;)
  {
  }
}




/*===========================================================================
    _ M C U _   A   T M E G A 1 2 8 _ T I M E R 1 _ I N I T
---------------------------------------------------------------------------*/
void _mcu_ATmega128_timer1_init(void)
{
  TCCR1A = 0x00;            /* WGM1[3:0] = 4 (CTC)              */
  TCCR1B = 0x0A;            /* prescaler = 8                    */
  TCCR1C = 0x00;

  OCR1A  = 20000 - 1;       /* (8 * (1 + 19999) ) / 16MHZ = 10ms */

  TCNT1  = 0;               /* Clear counter1                   */ 
  TIMSK = 1 << OCIE1A;      /* Enable OC1A interrupt            */
}


/*===========================================================================
    C O N F _ I N I T
---------------------------------------------------------------------------*/
void conf_init(void)
{
  /* RT-BOSS 스케줄러 시작 전 실행함. (인트럽트가 중지 상태에서 실행함) */
  _mcu_ATmega128_timer1_init();
  Boss_mem_free( Boss_mem_alloc(1) );         /* RT-BOSS 메모리 초기화 */
}


/*===========================================================================
   Timer Compare Match A  (ATmega128 Timer1 ISR)
---------------------------------------------------------------------------*/
ISR(TIMER1_COMPA_vect)
{
  _MCU_ISR_EXECUTE( _Boss_tick );
}


/*===========================================================================
    A S S E R T _ F A I L E D
---------------------------------------------------------------------------*/
unsigned int assert_line;

void assert_failed(unsigned int line)
{
  (void)_mcu_irq_lock();
  assert_line = line;

  while(line != 0)
  {
  }
}

